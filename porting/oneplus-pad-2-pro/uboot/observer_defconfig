## porting/oneplus-pad-2-pro/uboot/observer_defconfig
```kconfig
CONFIG_ARM=y
CONFIG_ARCH_SNAPDRAGON=y
CONFIG_OPD2413_OBSERVER=y
CONFIG_SKIP_LOWLEVEL_INIT=y
CONFIG_POSITION_INDEPENDENT=y
CONFIG_TEXT_BASE=0xb9000000
CONFIG_SYS_INIT_SP_BSS_OFFSET=0x400000
CONFIG_NR_DRAM_BANKS=24
CONFIG_SYS_MALLOC_LEN=0x800000
CONFIG_SYS_MALLOC_F_LEN=0x10000
CONFIG_SYS_LOAD_ADDR=0xb9000000
CONFIG_DEFAULT_DEVICE_TREE="opd2413-observer"
CONFIG_ENV_IS_NOWHERE=y
CONFIG_ENV_SIZE=0x4000
CONFIG_CONSOLE_MUX=y
CONFIG_SYS_CONSOLE_IS_IN_ENV=y
CONFIG_ENV_USE_DEFAULT_ENV_TEXT_FILE=y
CONFIG_ENV_DEFAULT_ENV_TEXT_FILE="board/qualcomm/opd2413-observer.env"
CONFIG_BOOTDELAY=0
CONFIG_CMD_BDI=y
CONFIG_CMD_ECHO=y
CONFIG_CMD_SLEEP=y
CONFIG_CMD_VERSION=y
CONFIG_CMD_FDT=y
CONFIG_CMD_LOG=y
CONFIG_USE_BOOTCOMMAND=y
# CONFIG_BOOTSTD is not set
# CONFIG_DISTRO_DEFAULTS is not set
# CONFIG_NET is not set
# CONFIG_CMD_NET is not set
# CONFIG_CMD_SAVEENV is not set
# CONFIG_CMD_FLASH is not set
# CONFIG_CMD_MEMORY is not set
# CONFIG_CMD_LOADB is not set
# CONFIG_CMD_LOADS is not set
# CONFIG_CMD_EDITENV is not set
# CONFIG_CMD_NVEDIT_EFI is not set
# CONFIG_MMC is not set
# CONFIG_SCSI is not set
# CONFIG_UFS is not set
# CONFIG_USB is not set
# CONFIG_PCI is not set
# CONFIG_MTD is not set
# CONFIG_EFI_LOADER is not set
# CONFIG_WDT is not set
# CONFIG_WATCHDOG is not set
# CONFIG_DM_RNG is not set
# CONFIG_OF_UPSTREAM is not set
# CONFIG_DISPLAY_CPUINFO is not set
CONFIG_DISPLAY_DRAM_CONFIG_VERBOSE=y
CONFIG_VIDEO=y
CONFIG_VIDEO_SIMPLE=y
CONFIG_VIDEO_FONT_16X32=y
# CONFIG_VIDEO_FONT_8X16 is not set
CONFIG_SYS_WHITE_ON_BLACK=y
CONFIG_SYS_CONSOLE_ENV_OVERWRITE=y

# CONFIG_TOOLS_LIBCRYPTO is not set
# CONFIG_TOOLS_KWBIMAGE is not set
```
